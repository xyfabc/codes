## scsi_vender_demo/linux-2.6.31.3/drivers/char/jzchar/Kconfig
```kconfig
#
# JzSOC char devices configuration
#

menu "JZSOC char device support"
	depends on SOC_JZ4740 || SOC_JZ4730 || SOC_JZ4750 || SOC_JZ4750D || SOC_JZ4760 || SOC_JZ4760B || SOC_JZ4770 || SOC_JZ4810 || SOC_JZ4780 || SOC_JZ4775

config JZCHAR
	tristate 'JzSOC char device support'
	depends on SOC_JZ4740 || SOC_JZ4730 || SOC_JZ4750 || SOC_JZ4750D || SOC_JZ4760 || SOC_JZ4760B || SOC_JZ4770 || SOC_JZ4810 || SOC_JZ4780 || SOC_JZ4775

config JZ_SIMPLE_I2C
	tristate 'Ingenic Simple I2C Userspace Driver'
	depends on SOC_JZ4740 || SOC_JZ4730 || SOC_JZ4750 || SOC_JZ4750D 

config JZ_GPIO_PM_KEY
	tristate 'Ingenic GPIO PM Key Driver'
	depends on SOC_JZ4740 || SOC_JZ4730 || SOC_JZ4750 || SOC_JZ4750D 

config JZ_TPANEL_ATA2508
	tristate 'JzSOC MPEG4 TOUCH PANEL ATA2508 support'
	depends on JZCHAR && (SOC_JZ4740 || SOC_JZ4730 || SOC_JZ4750 || SOC_JZ4750D)

#config JZ_TPANEL
#	tristate 'JzSOC touchpanel driver support' 
#	depends on JZCHAR

#	select JZ_SADC if SOC_JZ4740
#	select JZ_TPANEL_AK4182 if SOC_JZ4730

choice
	prompt "Touch Panel ADC type"
	depends on JZ_TPANEL
	default JZ_SADC if SOC_JZ4740 || SOC_JZ4750 || SOC_JZ4750D
	default JZ_TPANEL_AK4182 if SOC_JZ4730

config JZ_SADC
	bool 'Select the JZ47XX internal SADC'

config JZ_TPANEL_AK4182
	bool 'Select the AK4182 codec'

config JZ_TPANEL_UCB1400
	bool 'Select the UCB1400 codec'

config JZ_TPANEL_WM9712
	bool 'Select the WM9712 codec'

endchoice

config JZ_OW
	tristate 'JZ One-wire bus support' 
	depends on JZCHAR && (SOC_JZ4740 || SOC_JZ4730 || SOC_JZ4750 || SOC_JZ4750D)

config JZ_TCSM
	tristate 'JZ TCSM support' 
	depends on JZCHAR && (SOC_JZ4750 || SOC_JZ4750D || SOC_JZ4760 || SOC_JZ4760B || SOC_JZ4770 || SOC_JZ4810 || SOC_JZ4780 || SOC_JZ4775)

config JZ4770_TCU
	tristate 'Ingenic JZ4770 TCU Driver'
	depends on JZCHAR && SOC_JZ4770

config JZ_TSSI_4760
	tristate 'JZ MPEG2-TS interface support for JZ4760 or JZ4760B' 
	depends on JZCHAR && (SOC_JZ4760 || SOC_JZ4760B)

config JZ_TSSI_4780
        tristate 'JZ MPEG2-TS interface support for JZ4780'
        depends on JZCHAR && (SOC_JZ4780)

config JZ_WIEGAND
	tristate 'Wiegand impl on Ingenic Soc'
	depends on JZSOC

config JZ_KBD_BF6911AQ22
	tristate 'Select the HW_KBD_BF6911AQ22'

config JZ_IC_ID_CARD
	tristate 'Select the JZ_IC_ID_CARD'

config JZ_LED_RED_GREEN
	tristate 'Select the JZ_LED_RED_GREEN'

config HW_AT88
	tristate 'Select the AT88 Encryption chip'

config LED_PWM
	tristate 'Select the LED WITH PWM DRIVER'

config MISC_EVERY
	tristate 'Select the RELAY DIVER'

endmenu
```

## scsi_vender_demo/linux-2.6.31.3/drivers/misc/jz_cim/Kconfig
```kconfig
config JZ_CIM
	tristate "JZ CIM for Camera driver"

choice
	prompt "Select cim output format"
	depends on JZ_CIM && ( SOC_JZ4775 || SOC_JZ4780 )
	default JZ_CIM_OUT_FMT_BYPASS

config JZ_CIM_OUT_FMT_BYPASS
	bool 'Bypass Mode'

config JZ_CIM_OUT_FMT_YUV422
	bool 'CSC to YUV422'

config JZ_CIM_OUT_FMT_YUV420
	bool 'CSC to YUV420'

endchoice

choice
	prompt "Select cim input format(eg. sensor output format)"
	depends on JZ_CIM
	default JZ_CIM_IN_FMT_YUV422

config	JZ_CIM_IN_FMT_YUV444
	bool 'YUV444'

config	JZ_CIM_IN_FMT_YUV422
	bool 'YUV422'

config	JZ_CIM_IN_FMT_ITU656
	bool 'ITU656'

#config	JZ_CIM_IN_FMT_RGB565
#	bool 'RGB565'
#	depends on JZ_CIM_OUT_FMT_BYPASS

endchoice

choice
	prompt "Select camera sensor"
	depends on JZ_CIM
	default OV3640

config GC0303
	bool "GalaxyCore 0303 sensor support"
	depends on JZ_CIM

config GC0308
	bool "GalaxyCore 0308 sensor support"
	depends on JZ_CIM

config GC0307
	bool "GalaxyCore 0307 sensor support"
	depends on JZ_CIM

config BF3703
	bool "OmniVision BF3703 sensor support (0.3 MegaPixel)"
	depends on JZ_CIM
config OV3640
	bool "OmniVision OV3640 sensor support (3.1 MegaPixel)"
	depends on JZ_CIM
config OV2655
	bool "OmniVision OV2655 sensor support (2.0 MegaPixel)"
	depends on JZ_CIM
config CM3511
	bool "CM3511 sensor support (0.3 MegaPixel)"
	depends on JZ_CIM

config OV2640
	bool "OmniVision OV2640 sensor support (2.0 MegaPixel)"
	depends on JZ_CIM
config OV9650
	bool "OmniVision OV9650 sensor support (1.3 MegaPixel)"
	depends on JZ_CIM
config OV7690
	bool "OmniVision OV7690 sensor support (0.3 MegaPixel)"
	depends on JZ_CIM
config ISP
	bool "Corelogic isp with SamSung S5K sensor support (3.1 MegaPixel)"
	depends on JZ_CIM && JZ_I2C_SIMULATE
config JZ_FAKE_SENSOR
	bool "jz fake sensor support (3.1 MegaPixel)"
	depends on JZ_CIM
config JZ_TVP5150
	bool "TVP5150 video decorder"
	depends on JZ_CIM
endchoice

config JZ_CIM_VA
	bool 'Use Virtual Address'
	depends on JZ_CIM && ( SOC_JZ4775 || SOC_JZ4780 )
	default n
	help
	Use Virtual Address instead of Physical Address for Jz47xx CIM.
	
config JZ_CIM_MB
	bool 'Use Macro Block'
	depends on JZ_CIM && JZ_CIM_OUT_FMT_YUV420 && ( SOC_JZ4775 || SOC_JZ4780 )
	default n
	help
	Enable Macro Block Mode for CIM output format YCbCr420.

config JZ_CIM_FSC
	bool 'Enable Frame Size Check'
	depends on JZ_CIM && ( SOC_JZ4775 || SOC_JZ4780 )
	default y

config JZ_CIM_ARIF
	bool 'Enable Auto Recovery for Incomplete Frame'
	depends on JZ_CIM && JZ_CIM_FSC && ( SOC_JZ4775 || SOC_JZ4780 )
	default y

config JZ_CIM_0
	bool "Using Jz CIM Controller 0"
	depends on SOC_JZ4775
	default y
```

## scsi_vender_demo/linux-2.6.31.3/drivers/misc/jz_cim1/Kconfig
```kconfig
config JZ_CIM_1
	bool "Using Jz CIM Controller 1"
	depends on SOC_JZ4775
	default n
```

## scsi_vender_demo/linux-2.6.31.3/drivers/usb_0/gadget/hanvon_gadget/Kconfig
```kconfig
#
# USB Gadget support on a system involves
#    (a) a peripheral controller, and
#    (b) the gadget driver using it.
#
# NOTE:  Gadget support ** DOES NOT ** depend on host-side CONFIG_USB !!
#
#  - Host systems (like PCs) need CONFIG_USB (with "A" jacks).
#  - Peripherals (like PDAs) need CONFIG_USB_GADGET (with "B" jacks).
#  - Some systems have both kinds of controllers.
#
# With help from a special transceiver and a "Mini-AB" jack, systems with
# both kinds of controller can also support "USB On-the-Go" (CONFIG_USB_OTG).
#


config USB_HANVON_SCSI_COMMAND
	bool "Enable hanvon SCSI vendor command"
	depends on USB_FILE_STORAGE && (SOC_JZ4740 || SOC_JZ4750 || SOC_JZ4750D || SOC_JZ4760 || SOC_JZ4760B || SOC_JZ4770 || SOC_JZ4780 || SOC_JZ4775)
	default y
	help
	  say "y" to use hanvon SCSI Vendor Command.
	  say "n" to disable hanvon SCSI Vendor Command.
```
